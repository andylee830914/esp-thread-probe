## components/probe_core/Kconfig
```kconfig
menu "ESP Thread Probe"

config PROBE_UPLINK_UART_ENABLE
    bool "Enable UART telemetry uplink"
    default y
    help
        Expose probe telemetry over JSON-lines UART for a companion Wi-Fi MCU.

config PROBE_UPLINK_UART_NUM
    int "Uplink UART number"
    default 1
    depends on PROBE_UPLINK_UART_ENABLE

config PROBE_UPLINK_UART_TX_GPIO
    int "Uplink UART TX GPIO"
    default 4
    depends on PROBE_UPLINK_UART_ENABLE

config PROBE_UPLINK_UART_RX_GPIO
    int "Uplink UART RX GPIO"
    default 5
    depends on PROBE_UPLINK_UART_ENABLE

config PROBE_UPLINK_UART_BAUD
    int "Uplink UART baud rate"
    default 115200
    depends on PROBE_UPLINK_UART_ENABLE

config PROBE_THREAD_API_LOCK_TIMEOUT_MS
    int "Thread telemetry lock timeout in ms"
    default 0
    help
        Maximum time an HTTP telemetry request waits for the OpenThread API
        lock before returning a busy state.

choice PROBE_BOARD_LED_TYPE
    prompt "Board LED type"
    default PROBE_BOARD_LED_ADDRESSABLE

config PROBE_BOARD_LED_DISABLED
    bool "Disabled"

config PROBE_BOARD_LED_ADDRESSABLE
    bool "Addressable RGB LED"
    help
        Use this for ESP32-C6 DevKit boards with an onboard WS2812/SK6812 RGB LED.

config PROBE_BOARD_LED_GPIO
    bool "Plain GPIO LED"
    help
        Use this for boards with a simple single-color LED driven by GPIO level.

endchoice

config PROBE_BOARD_LED_GPIO_NUM
    int "Board LED GPIO"
    default 8

config PROBE_BOARD_LED_ACTIVE_HIGH
    bool "Board LED active high"
    default y
    depends on PROBE_BOARD_LED_GPIO

config PROBE_BOARD_LED_BRIGHTNESS
    int "Board RGB LED brightness"
    range 1 255
    default 16
    depends on PROBE_BOARD_LED_ADDRESSABLE

endmenu
```

## firmware/uplink-wroom32/main/Kconfig.projbuild
```kconfig
menu "ESP Thread Probe Uplink"

config UPLINK_WIFI_SSID
    string "Wi-Fi SSID"
    default ""

config UPLINK_WIFI_PASSWORD
    string "Wi-Fi Password"
    default ""

config UPLINK_HTTP_PORT
    int "HTTP server port"
    default 80

config UPLINK_UART_NUM
    int "Probe UART number"
    default 1

config UPLINK_UART_TX_GPIO
    int "Probe UART TX GPIO"
    default 17

config UPLINK_UART_RX_GPIO
    int "Probe UART RX GPIO"
    default 16

config UPLINK_UART_BAUD
    int "Probe UART baud rate"
    default 115200

config UPLINK_PROBE_TIMEOUT_MS
    int "Probe UART timeout in ms"
    default 8000

endmenu
```

## firmware/uplink-wroom32/sdkconfig.defaults
```kconfig
CONFIG_IDF_TARGET="esp32"
CONFIG_ESPTOOLPY_FLASHSIZE_4MB=y
CONFIG_ESPTOOLPY_FLASHSIZE="4MB"
CONFIG_ESP_WIFI_STA_DISCONNECTED_PM_ENABLE=n
CONFIG_ESP_WIFI_AMPDU_TX_ENABLED=n
CONFIG_ESP_WIFI_AMPDU_RX_ENABLED=n
CONFIG_HTTPD_MAX_REQ_HDR_LEN=1024
CONFIG_HTTPD_MAX_URI_LEN=512
CONFIG_LWIP_MAX_SOCKETS=10
CONFIG_UPLINK_HTTP_PORT=80
CONFIG_UPLINK_UART_NUM=1
CONFIG_UPLINK_UART_TX_GPIO=17
CONFIG_UPLINK_UART_RX_GPIO=16
CONFIG_UPLINK_UART_BAUD=115200
CONFIG_UPLINK_PROBE_TIMEOUT_MS=2500
```

## sdkconfig.defaults
```kconfig
CONFIG_IDF_TARGET="esp32c6"
CONFIG_ESPTOOLPY_FLASHSIZE_4MB=y
CONFIG_ESPTOOLPY_FLASHSIZE="4MB"
CONFIG_BT_ENABLED=y
CONFIG_BT_NIMBLE_ENABLED=y
CONFIG_BT_NIMBLE_EXT_ADV=n
CONFIG_BT_NIMBLE_TRANSPORT_EVT_SIZE=70
CONFIG_USE_BLE_ONLY_FOR_COMMISSIONING=y
CONFIG_PARTITION_TABLE_CUSTOM=y
CONFIG_PARTITION_TABLE_CUSTOM_FILENAME="partitions.csv"
# Matter commissioning is Thread-only for this project. In the dual-MCU
# architecture, the ESP32-C6 does not run Wi-Fi station or HTTP telemetry.
# Wi-Fi and HTTP live on firmware/uplink-wroom32.
# CONFIG_ENABLE_WIFI_STATION is not set
# CONFIG_WIFI_NETWORK_COMMISSIONING_DRIVER is not set
# CONFIG_ENABLE_WIFI_TELEMETRY is not set
CONFIG_OPENTHREAD_ENABLED=y
CONFIG_OPENTHREAD_FTD=y
CONFIG_OPENTHREAD_SRP_CLIENT=y
CONFIG_OPENTHREAD_DNS_CLIENT=y
CONFIG_OPENTHREAD_HEADER_CUSTOM=y
CONFIG_OPENTHREAD_CUSTOM_HEADER_PATH="openthread_custom"
CONFIG_OPENTHREAD_CUSTOM_HEADER_FILE_NAME="openthread_config.h"
CONFIG_OPENTHREAD_LOG_LEVEL_DYNAMIC=n
# Keep OpenThread core quiet enough that duplicate MLE warnings do not starve
# Wi-Fi HTTP telemetry on small devices while still surfacing critical issues.
CONFIG_OPENTHREAD_LOG_LEVEL_CRIT=y
CONFIG_OPENTHREAD_LOG_LEVEL=1
CONFIG_OPENTHREAD_CLI=n
CONFIG_OPENTHREAD_RADIO_NATIVE=y
CONFIG_LWIP_IPV6_AUTOCONFIG=n
CONFIG_LWIP_IPV6_NUM_ADDRESSES=8
CONFIG_LWIP_MULTICAST_PING=y
CONFIG_LWIP_HOOK_IP6_ROUTE_DEFAULT=y
CONFIG_LWIP_HOOK_ND6_GET_GW_DEFAULT=y
CONFIG_ENABLE_ROUTE_HOOK=y
CONFIG_USE_MINIMAL_MDNS=n
CONFIG_ENABLE_EXTENDED_DISCOVERY=y
CONFIG_MBEDTLS_X509_CREATE_C=y
CONFIG_MBEDTLS_X509_CSR_WRITE_C=y
CONFIG_ENABLE_OTA_REQUESTOR=n
CONFIG_ENABLE_CHIP_SHELL=n
CONFIG_ENABLE_PERSIST_SUBSCRIPTIONS=n
CONFIG_MRP_LOCAL_ACTIVE_RETRY_INTERVAL_FOR_THREAD=5000
CONFIG_MRP_LOCAL_IDLE_RETRY_INTERVAL_FOR_THREAD=5000
CONFIG_MRP_RETRY_INTERVAL_SENDER_BOOST_FOR_THREAD=5000
CONFIG_MRP_MAX_RETRANS=3
CONFIG_PROBE_UPLINK_UART_ENABLE=y
CONFIG_PROBE_UPLINK_UART_NUM=1
CONFIG_PROBE_UPLINK_UART_TX_GPIO=4
CONFIG_PROBE_UPLINK_UART_RX_GPIO=5
CONFIG_PROBE_UPLINK_UART_BAUD=115200
CONFIG_PROBE_THREAD_API_LOCK_TIMEOUT_MS=0
CONFIG_PROBE_BOARD_LED_ADDRESSABLE=y
CONFIG_PROBE_BOARD_LED_GPIO_NUM=8
CONFIG_PROBE_BOARD_LED_BRIGHTNESS=16
CONFIG_SUPPORT_CLOSURE_CONTROL_CLUSTER=n
CONFIG_SUPPORT_CLOSURE_DIMENSION_CLUSTER=n
CONFIG_SUPPORT_WIFI_NETWORK_DIAGNOSTICS_CLUSTER=n
CONFIG_SUPPORT_WIFI_NETWORK_MANAGEMENT_CLUSTER=n
```
